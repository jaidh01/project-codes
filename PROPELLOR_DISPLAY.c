#include<avr/io.h>
#define F_CPU 8000000UL
#include<util/delay.h>
#include<ctype.h>
#include<avr/interrupt.h>
#include<string.h>
#define BR 9600UL
#define PS ((F_CPU/(16*BR))-1)
//#include<stdlib.h>

//sci();

// char head[50]={"XANANOIDS"};
  
/*
void serialbegin()
{
  UBRRL=PS;
  UBRRH=PS/256;
  UCSRB=(1<<RXEN)+(1<<TXEN);
  UCSRC=(1<<URSEL)+(1<<UCSZ1)+(1<<UCSZ0);
}

void txdata(char tx)
{
  while(!(UCSRA &(1<<UDRE)));
  UDR=tx;
}

char rxdata()
{
  while(!(UCSRA &(1<<RXC)));
  return UDR;
}

void tx_string(char a[])
{
	int b=0;
	for(b=0;a[b]!='\0';b++)
	{
		txdata(a[b]);
	}
}

char* rx_string()
{
    char *name;
	name=(char*)calloc(1,1);
	int ch=0,i=0;

	ch=rxdata();
	for(i=0;ch!=13;i++)
	{
	   *(name+i)=ch;
	   ch=rxdata();
	   name=(char*)realloc(name,(i+2));
    }
	*(name+i)='\0';
	return(name);
}




void timer0_init()
{
   TCCR0|=(1<<CS02)|(1<<CS00);
   TCNT0=0;

}
void tx_num(int n)
{
	if(n<10)
	{
		txdata(n+48);
	}
	else
	{
		tx_num(n/10);
		txdata((n%10)+48);
	}

}
*/
void prop_disp(char line[],int m)
{


            int len=strlen(line);   //  to calculate the length of string
		//	int x=0,y=0,z=0,p=0,i=0,t=0;
	       // char alp;
  char col[27][8]={
               
			   
			   {0b11111000,     //A
                0b00001100,
			    0b00001010,
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				0,
				0}};



	char new_col[27][8]=	{{31,
                             48,
                             80,
                             144,
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                             248,
                             },
                            {255,
                             2,
                             4,
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                             0,
                             0}};
////////////////////////////////////////////////////////////////////////////
// to rotate the alphabet by 90 degree
      int y=0,i12=0;


/*     int x=0,sft=0,z=0;
	  char new_col[26][8];
	  for(x=0;x<26;x++)
      {
      for(y=0,sft=1;y<8;y++,sft*=2)
	  {
	     for(z=0;z<8;z++)
		 {
		    new_col[x][y]+=(col[x][z]&&(128/sft));
		 }

	  }
   }
*/
      
	 

/////////////////////////////////////////////////////////////////////////////////
// to create  new array for reverse print

//	   char new_col[26][8];
//	  int x=0,z=0,z1=0;
/*
	  for(x=0;x<26;x++)
	  {
	     for(y=0;y<8;y++)
		 {
		    new_col[x][y]=0;
	     }
      }
	  	  
	  for(x=0;x<26;x++)
	  {
	     for(y=0,y1=7;y<8;y++,y1--)
		 {
		    for(z=1,z1=128;z<=128;z*=2,z1/=2)
			{
			   if((col[x][y]&z)==z)
			   {
			      new_col[x][y1]=((new_col[x][y1]&(~z1))+z1);
               }
			   else if((col[x][y]&z)==0)
   			      new_col[x][y1]=((new_col[x][y1]&(~z1))+0);            
			}
		 } 
	  }
*/

/*
	  for(x=0;x<26;x++)
	  {
	     for(y=0,z=1,z1=128;y<8;y++,z*=2,z1/=2)
		 {
		       new_col[x][y]=~(new_col[x][y]);
		 } 
	  }

*/
/////////////////////////////////////////////////////////////////////////////////

// to print on display
	  for(y=0;y<len;)
	  {
		int alp=toupper(line[y]);
		 if(alp<=60)
		   {
              	alp=91;
		   }
		for(i12=0;i12<8;i12++)
		{           
		   if(m==2)
		   {
 		      
		   PORTA=new_col[(alp-65)][i12];
		  
		   }
		   else if(m==1)
		   {
		      
		     PORTA=col[(alp-65)][i12];
		   
		   }
      	   _delay_us(100);
		   PORTA=0x00;	
	 
		}
		 y++;
		 PORTA=0x00;
		_delay_us(250);
	  }   

///////////////////////////////////////////////////////////////////////////////////////////////////

}
/*
ISR(INT0_vect)
{
  prop_disp("XANANOIDS");  
}


*/

int main()
{
   
   DDRA=0xff;
  
 /*  GICR=0B01000000;
   MCUCR=0X01;
   DDRD=0B11111011;
  
   */
   DDRB=0;
   DDRC=0;
   PORTB=0;
   PORTC=0;
   DDRD=0B11111011;
  // serialbegin();
   //tx_string(head);

   while(1)
   {
       
				 
		 if((PIND&0B00000100)==0)
		 {
		    
	         while((PIND&&0B00000100)==0);
		     prop_disp("WELCOME TO",1);
			 _delay_us(8000);
			 prop_disp("SDIONANAX",2);       	        
	     }
		 
   }     
}
